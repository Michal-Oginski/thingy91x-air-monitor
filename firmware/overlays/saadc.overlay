/*
 * ALTERNATIVE (not recommended for raw cells): nRF9151 built-in ADC on
 * P0.18 (AIN5, TP32) and P0.19 (AIN6, TP33).
 *
 * WARNING: on the Thingy:91 X these pins also connect to the TXS0102 level
 * shifter (U24) for the STEMMA QT / Qwiic expansion port. Its internal
 * pull-ups and edge accelerators load the pins, which ruins millivolt-level
 * readings from a raw galvanic cell. Only consider this for an AMPLIFIED
 * sensor with a low-impedance output, with SB8/SB9 open and nothing plugged
 * into the expansion port - and verify the readings against a reference.
 *
 * Build with:
 *   west build -b thingy91x/nrf9151/ns -- -DEXTRA_CONF_FILE=secrets.conf \
 *       -DEXTRA_DTC_OVERLAY_FILE=overlays/saadc.overlay
 */

#include <zephyr/dt-bindings/adc/adc.h>
#include <zephyr/dt-bindings/adc/nrf-saadc.h>

/ {
	zephyr,user {
		io-channels = <&adc 0>;
	};
};

&adc {
	#address-cells = <1>;
	#size-cells = <0>;
	status = "okay";

	channel@0 {
		reg = <0>;
		zephyr,gain = "ADC_GAIN_4";
		zephyr,reference = "ADC_REF_INTERNAL";
		zephyr,acquisition-time = <ADC_ACQ_TIME(ADC_ACQ_TIME_MICROSECONDS, 40)>;
		zephyr,input-positive = <NRF_SAADC_AIN5>; /* P0.18, TP32 */
		zephyr,input-negative = <NRF_SAADC_AIN6>; /* P0.19, TP33 */
		zephyr,resolution = <14>;
		zephyr,oversampling = <8>;                /* 2^8 = 256 samples averaged */
	};
};
