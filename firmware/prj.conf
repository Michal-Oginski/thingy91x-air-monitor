## CMakeLists.txt
```
cmake_minimum_required(VERSION 3.20.0)

find_package(Zephyr REQUIRED HINTS $ENV{ZEPHYR_BASE})
project(thingy91x_air_monitor)

target_sources(app PRIVATE
  src/main.c
  src/gnss.c
  src/env.c
  src/manual_loc.c
)

# Embed the Mikrus MQTT broker CA as a C string
set(gen_dir ${CMAKE_CURRENT_BINARY_DIR}/generated)
zephyr_include_directories(${gen_dir})
generate_inc_file_for_target(app
  ${CMAKE_CURRENT_SOURCE_DIR}/cert/mikrus_ca.pem
  ${gen_dir}/ca_cert.pem.inc)
```

## Kconfig
```
menu "Thingy:91 X air monitor"

config APP_MQTT_HOST
	string "MQTT broker hostname"
	default "srv72.mikr.us"

config APP_MQTT_PORT
	int "MQTT broker port (TLS)"
	default 40022

config APP_MQTT_USER
	string "MQTT username"
	default "thingy91x"

config APP_MQTT_PASSWORD
	string "MQTT password (set this in secrets.conf, never commit it)"
	default ""

config APP_MQTT_TOPIC
	string "Environment publish topic"
	default "sensors/thingy91x/env"

config APP_MQTT_KEEPALIVE_S
	int "MQTT keepalive (seconds)"
	default 120

config APP_SEC_TAG
	int "Modem security tag used for the broker CA certificate"
	default 4242

config APP_ENV_PUBLISH_INTERVAL_S
	int "Environment publish interval (seconds)"
	default 30
	range 5 3600

config APP_ENV_SAMPLE_INTERVAL_S
	int "BME688 sensor sample interval (seconds)"
	default 10
	range 1 3600

# ---- Location ----

config APP_GNSS_INTERVAL_S
	int "Interval between automatic location fixes (seconds)"
	default 600
	range 0 65535

config APP_GNSS_TIMEOUT_S
	int "Give up on an automatic GNSS fix after (seconds)"
	default 300

config APP_FIXED_LAT
	string "Manual location: latitude (decimal degrees, empty = off)"
	default ""

config APP_FIXED_LON
	string "Manual location: longitude (decimal degrees, empty = off)"
	default ""

config APP_FIXED_LOCATION_ALWAYS
	bool "Do not run GNSS/Wi-Fi/cell location (manual location only)"
	default n

config APP_LOCATION_WIFI_FIRST
	bool "Try Wi-Fi before GNSS"
	default y

endmenu

source "Kconfig.zephyr"
```

## prj.conf
```kconfig
# ---------- Logging ----------
CONFIG_LOG=y
CONFIG_LOG_DEFAULT_LEVEL=3
CONFIG_PICOLIBC=y
CONFIG_CBPRINTF_FP_SUPPORT=y
CONFIG_PICOLIBC_IO_FLOAT=y
CONFIG_HW_STACK_PROTECTION=y
CONFIG_MAIN_STACK_SIZE=4096
CONFIG_SYSTEM_WORKQUEUE_STACK_SIZE=2048
CONFIG_HEAP_MEM_POOL_SIZE=16384

# ---------- Modem / LTE ----------
CONFIG_NRF_MODEM_LIB=y
CONFIG_LTE_LINK_CONTROL=y
CONFIG_LTE_LC_PSM_MODULE=y
CONFIG_LTE_PSM_REQ=y
CONFIG_LTE_NETWORK_MODE_LTE_M_NBIOT_GPS=y
CONFIG_MODEM_KEY_MGMT=y

# ---------- Networking (LTE sockets offloaded to the modem) ----------
CONFIG_NETWORKING=y
CONFIG_NET_SOCKETS=y
CONFIG_NET_SOCKETS_OFFLOAD=y
# NET_NATIVE is enabled in the Wi-Fi section below (needed by the nRF7002 driver)

# ---------- MQTT over TLS ----------
CONFIG_MQTT_LIB=y
CONFIG_MQTT_LIB_TLS=y
CONFIG_MQTT_CLEAN_SESSION=y

# ---------- Location: Wi-Fi + GNSS + cellular, looked up via nRF Cloud ----------
CONFIG_LOCATION=y
CONFIG_LOCATION_METHOD_GNSS=y
CONFIG_LOCATION_METHOD_CELLULAR=y
CONFIG_LOCATION_METHOD_WIFI=y
CONFIG_LOCATION_SERVICE_NRF_CLOUD=y
CONFIG_LOCATION_METHOD_WIFI_SCANNING_RESULTS_MAX_CNT=20

# nRF Cloud over CoAP (location lookups + A-GNSS only; data still goes to MQTT)
CONFIG_NRF_CLOUD=y
CONFIG_NRF_CLOUD_COAP=y
CONFIG_NRF_CLOUD_CHECK_CREDENTIALS=y
CONFIG_NRF_CLOUD_AGNSS=y
CONFIG_MODEM_INFO=y
CONFIG_MODEM_INFO_ADD_NETWORK=y
CONFIG_MODEM_JWT=y
CONFIG_COAP_CLIENT_BLOCK_SIZE=1024
CONFIG_COAP_CLIENT_STACK_SIZE=2048
CONFIG_COAP_CLIENT_THREAD_PRIORITY=0
CONFIG_AT_MONITOR_HEAP_SIZE=1024

# nRF7002 Wi-Fi in scan-only mode (from Nordic's location sample for Thingy:91 X)
CONFIG_WIFI=y
CONFIG_WIFI_NRF70=y
CONFIG_WIFI_NRF70_SKIP_LOCAL_ADMIN_MAC=y
CONFIG_NRF_WIFI_SCAN_MAX_BSS_CNT=20
CONFIG_NRF_WIFI_CTRL_HEAP_SIZE=10240
CONFIG_HEAP_MEM_POOL_IGNORE_MIN=y
CONFIG_WIFI_NM_WPA_SUPPLICANT=n
CONFIG_NET_DEFAULT_IF_ETHERNET=y
CONFIG_MBEDTLS=n
CONFIG_NET_L2_ETHERNET=y
CONFIG_NET_NATIVE=y
CONFIG_NET_IPV4=y
CONFIG_NET_DHCPV4=y
CONFIG_NET_STATISTICS=y
CONFIG_NET_STATISTICS_WIFI=y
CONFIG_NET_STATISTICS_USER_API=y
CONFIG_NET_CONTEXT_SYNC_RECV=y
CONFIG_NET_BUF_RX_COUNT=1
CONFIG_NET_BUF_TX_COUNT=1
CONFIG_NET_PKT_RX_COUNT=1
CONFIG_NET_PKT_TX_COUNT=1
CONFIG_NET_TX_STACK_SIZE=512
CONFIG_NET_RX_STACK_SIZE=512
CONFIG_NET_TC_TX_COUNT=1
CONFIG_NET_MAX_CONTEXTS=1
CONFIG_NET_MGMT_EVENT_STACK_SIZE=1024

# ---------- I2C (built-in BME688) ----------
CONFIG_I2C=y

# ---------- Settings storage (manual location) ----------
CONFIG_FLASH=y
CONFIG_FLASH_MAP=y
CONFIG_NVS=y
CONFIG_SETTINGS=y
CONFIG_SETTINGS_NVS=y

# ---------- Pressure/temperature (BME688) and network time ----------
CONFIG_SENSOR=y
CONFIG_DATE_TIME=y

# ---------- Button and RGB LED ----------
CONFIG_DK_LIBRARY=y

# ---------- Serial commands ("loc set <lat> <lon>") ----------
CONFIG_SHELL=y
CONFIG_SHELL_BACKEND_SERIAL=y
CONFIG_SHELL_STACK_SIZE=3072
CONFIG_SHELL_PROMPT_UART="air:~$ "
```

## o2.conf
```kconfig
# O2 sensor build. Use together with an ADC overlay:
#   west build -b thingy91x/nrf9151/ns -- \
#     -DEXTRA_CONF_FILE="secrets.conf;o2.conf" \
#     -DEXTRA_DTC_OVERLAY_FILE=overlays/ads1115.overlay
CONFIG_APP_SENSOR_O2=y
CONFIG_ADC=y
```

## boards/thingy91x_nrf9151_ns.overlay
```dts
/*
 * Thingy:91 X (nRF9151) - onboard air monitor board overlay
 */

/* nRF7002 Wi-Fi chip, used for Wi-Fi location (scan only) */
#include <thingy91x_wifi.dtsi>

/* Built-in BME688: pressure, temperature, humidity and gas resistance */
&bme680 {
	status = "okay";
};
```

## dts/bindings/ams,iaq-core.yaml
```yaml
description: |
  ams iAQ-Core indoor air quality sensor module (CO2-eq / TVOC-eq).
  Read-only I2C device at 0x5A, 100 kHz, needs clock stretching.
  Never address it with the write bit (see the datasheet).

compatible: "ams,iaq-core"

include: i2c-device.yaml
```

## src/main.c
```c
#include <stdio.h>
#include <string.h>
#include <zephyr/kernel.h>
#include <zephyr/logging/log.h>
#include <zephyr/net/socket.h>
#include <zephyr/net/mqtt.h>
#include <zephyr/sys/atomic.h>
#include <nrf_modem_at.h>
#include <modem/nrf_modem_lib.h>
#include <modem/lte_lc.h>
#include <modem/modem_key_mgmt.h>
#include <dk_buttons_and_leds.h>

#include "gnss.h"
#include "manual_loc.h"
#include "env.h"

LOG_MODULE_REGISTER(thingy91x_main, LOG_LEVEL_INF);

#if !defined(NET_AF_INET)
#define NET_AF_INET AF_INET
#define NET_SOCK_STREAM SOCK_STREAM
#define net_sockaddr_in sockaddr_in
#define net_sockaddr_storage sockaddr_storage
#define net_htons htons
#endif
#if !defined(ZSOCK_TLS_PEER_VERIFY_REQUIRED)
#define ZSOCK_TLS_PEER_VERIFY_REQUIRED TLS_PEER_VERIFY_REQUIRED
#define ZSOCK_TLS_SESSION_CACHE_DISABLED TLS_SESSION_CACHE_DISABLED
#endif

#define LED_RED DK_LED1
#define LED_GREEN DK_LED2
#define LED_BLUE DK_LED3
#define RECONNECT_DELAY_MS (30 * MSEC_PER_SEC)

/* Mikrus MQTT broker CA, embedded at build time */
static const char ca_cert[] = {
#include "ca_cert.pem.inc"
	0x00
};

static atomic_t lte_ready;
static atomic_t button_send;
static struct mqtt_client client;
static struct net_sockaddr_storage broker;
static struct zsock_pollfd fds;
static bool mqtt_open;
static bool mqtt_connected;
static uint16_t msg_id;
static uint8_t rx_buf[256];
static uint8_t tx_buf[768];
static char client_id[48] = "thingy91x";
static bool env_ok;
static struct gnss_fix pending_fix;
static bool fix_pending;
static int64_t fix_time_ms;

static void button_handler(uint32_t state, uint32_t changed)
{
	if ((changed & DK_BTN1_MSK) && (state & DK_BTN1_MSK)) {
		atomic_set(&button_send, 1);
	}
}

static void lte_handler(const struct lte_lc_evt *evt)
{
	if (evt->type == LTE_LC_EVT_NW_REG_STATUS) {
		bool registered = evt->nw_reg_status == LTE_LC_NW_REG_REGISTERED_HOME ||
				  evt->nw_reg_status == LTE_LC_NW_REG_REGISTERED_ROAMING;

		if (registered != (bool)atomic_get(&lte_ready)) {
			LOG_INF("LTE %s", registered ? "connected" : "disconnected");
		}
		atomic_set(&lte_ready, registered);
	}
}

static int provision_ca_cert(void)
{
	bool exists = false;
	int err = modem_key_mgmt_exists(CONFIG_APP_SEC_TAG,
					MODEM_KEY_MGMT_CRED_TYPE_CA_CHAIN, &exists);

	if (err) {
		LOG_ERR("modem_key_mgmt_exists: %d", err);
		return err;
	}

	if (exists &&
	    modem_key_mgmt_cmp(CONFIG_APP_SEC_TAG, MODEM_KEY_MGMT_CRED_TYPE_CA_CHAIN,
			       ca_cert, strlen(ca_cert)) == 0) {
		return 0;
	}

	if (exists) {
		modem_key_mgmt_delete(CONFIG_APP_SEC_TAG,
				      MODEM_KEY_MGMT_CRED_TYPE_CA_CHAIN);
	}

	LOG_INF("Writing CA certificate to sec tag %d", CONFIG_APP_SEC_TAG);
	return modem_key_mgmt_write(CONFIG_APP_SEC_TAG,
				    MODEM_KEY_MGMT_CRED_TYPE_CA_CHAIN,
				    ca_cert, strlen(ca_cert));
}

static void read_imei_client_id(void)
{
	char imei[32] = { 0 };

	if (nrf_modem_at_cmd(imei, sizeof(imei), "AT+CGSN") == 0) {
		imei[15] = '\0';
		snprintf(client_id, sizeof(client_id), "thingy91x-%s", imei);
	}
	LOG_INF("MQTT client ID: %s", client_id);
}

static void mqtt_evt_handler(struct mqtt_client *c, const struct mqtt_evt *evt)
{
	ARG_UNUSED(c);

	switch (evt->type) {
	case MQTT_EVT_CONNACK:
		if (evt->result == 0) {
			mqtt_connected = true;
			LOG_INF("MQTT connected to %s", CONFIG_APP_MQTT_HOST);
		} else {
			LOG_ERR("MQTT connection refused (%d)", evt->result);
		}
		break;
	case MQTT_EVT_DISCONNECT:
		LOG_WRN("MQTT disconnected (%d)", evt->result);
		mqtt_connected = false;
		mqtt_open = false;
		break;
	case MQTT_EVT_PUBACK:
	case MQTT_EVT_PINGRESP:
		break;
	default:
		break;
	}
}

static int broker_resolve(void)
{
	struct zsock_addrinfo hints = {
		.ai_family = NET_AF_INET,
		.ai_socktype = NET_SOCK_STREAM,
	};
	struct zsock_addrinfo *res;
	int err = zsock_getaddrinfo(CONFIG_APP_MQTT_HOST, NULL, &hints, &res);

	if (err) {
		LOG_ERR("DNS lookup of %s failed: %d", CONFIG_APP_MQTT_HOST, err);
		return -EIO;
	}

	struct net_sockaddr_in *b4 = (struct net_sockaddr_in *)&broker;
	memcpy(b4, res->ai_addr, sizeof(*b4));
	b4->sin_family = NET_AF_INET;
	b4->sin_port = net_htons(CONFIG_APP_MQTT_PORT);
	zsock_freeaddrinfo(res);
	return 0;
}

static int mqtt_start(void)
{
	static sec_tag_t sec_tags[] = { CONFIG_APP_SEC_TAG };
	static struct mqtt_utf8 user = {
		.utf8 = (uint8_t *)CONFIG_APP_MQTT_USER,
		.size = sizeof(CONFIG_APP_MQTT_USER) - 1,
	};
	static struct mqtt_utf8 pass = {
		.utf8 = (uint8_t *)CONFIG_APP_MQTT_PASSWORD,
		.size = sizeof(CONFIG_APP_MQTT_PASSWORD) - 1,
	};
	int err = broker_resolve();

	if (err) {
		return err;
	}

	mqtt_client_init(&client);
	client.broker = &broker;
	client.evt_cb = mqtt_evt_handler;
	client.client_id.utf8 = (uint8_t *)client_id;
	client.client_id.size = strlen(client_id);
	client.user_name = &user;
	client.password = &pass;
	client.protocol_version = MQTT_VERSION_3_1_1;
	client.keepalive = CONFIG_APP_MQTT_KEEPALIVE_S;
	client.rx_buf = rx_buf;
	client.rx_buf_size = sizeof(rx_buf);
	client.tx_buf = tx_buf;
	client.tx_buf_size = sizeof(tx_buf);

	client.transport.type = MQTT_TRANSPORT_SECURE;
	struct mqtt_sec_config *tls = &client.transport.tls.config;
	tls->peer_verify = ZSOCK_TLS_PEER_VERIFY_REQUIRED;
	tls->cipher_list = NULL;
	tls->cipher_count = 0;
	tls->sec_tag_list = sec_tags;
	tls->sec_tag_count = ARRAY_SIZE(sec_tags);
	tls->hostname = CONFIG_APP_MQTT_HOST;
	tls->session_cache = ZSOCK_TLS_SESSION_CACHE_DISABLED;

	mqtt_connected = false;
	err = mqtt_connect(&client);
	if (err) {
		LOG_ERR("mqtt_connect failed: %d", err);
		return err;
	}

	mqtt_open = true;
	fds.fd = client.transport.tls.sock;
	fds.events = ZSOCK_POLLIN;

	for (int i = 0; i < 10 && mqtt_open && !mqtt_connected; i++) {
		if (zsock_poll(&fds, 1, MSEC_PER_SEC) > 0) {
			mqtt_input(&client);
		}
	}

	if (!mqtt_connected) {
		if (mqtt_open) {
			mqtt_abort(&client);
			mqtt_open = false;
		}
		return -ETIMEDOUT;
	}
	return 0;
}

static void mqtt_service(int timeout_ms)
{
	if (!mqtt_open) {
		k_msleep(timeout_ms);
		return;
	}

	int ret = zsock_poll(&fds, 1, timeout_ms);
	if (ret > 0) {
		if (fds.revents & ZSOCK_POLLIN) {
			mqtt_input(&client);
		}
		if (fds.revents & (ZSOCK_POLLERR | ZSOCK_POLLHUP | ZSOCK_POLLNVAL)) {
			mqtt_abort(&client);
			mqtt_open = false;
			mqtt_connected = false;
		}
	}

	if (mqtt_open) {
		mqtt_live(&client);
	}
}

static int publish_environment(const struct env_reading *reading)
{
	char payload[320];
	int len = snprintf(payload, sizeof(payload),
			   "{\"status\":\"ok\",\"temperature\":%.2f,\"pressure\":%.2f,"
			   "\"humidity\":%.2f,\"gas_resistance\":%.0f",
			   (double)reading->temperature_c, (double)reading->pressure_kpa,
			   (double)reading->humidity_pct,
			   (double)reading->gas_resistance_ohm);

	if (fix_pending) {
		len += snprintf(payload + len, sizeof(payload) - len,
				",\"lat\":%.6f,\"lon\":%.6f,\"acc\":%.0f,\"loc\":\"%s\","
				"\"fix_age\":%lld",
				pending_fix.lat, pending_fix.lon,
				(double)pending_fix.acc_m,
				pending_fix.method ? pending_fix.method : "gnss",
				(long long)((k_uptime_get() - fix_time_ms) / 1000));
	}
	len += snprintf(payload + len, sizeof(payload) - len, "}");

	struct mqtt_publish_param publish = {
		.message.topic.qos = MQTT_QOS_1_AT_LEAST_ONCE,
		.message.topic.topic.utf8 = (uint8_t *)CONFIG_APP_MQTT_TOPIC,
		.message.topic.topic.size = sizeof(CONFIG_APP_MQTT_TOPIC) - 1,
		.message.payload.data = (uint8_t *)payload,
		.message.payload.len = strlen(payload),
		.message_id = ++msg_id,
		.retain_flag = 0,
	};

	if (!mqtt_connected) {
		return -ENOTCONN;
	}

	int err = mqtt_publish(&client, &publish);
	if (err) {
		LOG_WRN("Publish failed: %d", err);
	} else {
		LOG_INF("Sent: %s", payload);
	}
	return err;
}

static void network_step(int64_t now, int64_t *next_connect, int64_t *next_publish)
{
	struct gnss_fix fix;
	double manual_lat;
	double manual_lon;
	bool manual = manual_loc_get(&manual_lat, &manual_lon);

	if (manual_loc_changed()) {
		if (manual) {
			pending_fix = (struct gnss_fix){
				.lat = manual_lat,
				.lon = manual_lon,
				.acc_m = 0.0f,
				.method = "manual",
			};
			fix_pending = true;
			fix_time_ms = now;
		} else {
			fix_pending = false;
		}
		*next_publish = 0;
	}

	if (gnss_take_new_fix(&fix) && !manual) {
		pending_fix = fix;
		fix_pending = true;
		fix_time_ms = now;
		*next_publish = 0;
	}

	static bool gnss_started;
	if (!gnss_started && atomic_get(&lte_ready) &&
	    !IS_ENABLED(CONFIG_APP_FIXED_LOCATION_ALWAYS)) {
		gnss_started = true;
		if (gnss_start()) {
			LOG_WRN("GNSS/location service not started");
		}
	}

	if (gnss_started) {
		gnss_service();
	}

	if (!mqtt_open && atomic_get(&lte_ready) && now >= *next_connect) {
		if (mqtt_start() != 0) {
			*next_connect = now + RECONNECT_DELAY_MS;
		}
	}
}

static void update_leds(uint32_t tick, bool sent)
{
	bool blink = tick & 1;
	bool red = false;
	bool green = false;
	bool blue = false;

	if (!env_ok) {
		red = blink;
	} else if (!mqtt_connected) {
		red = blink;
		green = blink;
	} else if (sent) {
		green = true;
	}

	dk_set_led(LED_RED, red);
	dk_set_led(LED_GREEN, green);
	dk_set_led(LED_BLUE, blue);
}

int main(void)
{
	int err;
	uint32_t tick = 0;
	int64_t next_publish = 0;
	int64_t next_connect = 0;

	LOG_INF("Thingy:91 X environment monitor starting");

	dk_leds_init();
	dk_buttons_init(button_handler);
	env_ok = env_init() == 0;

	err = nrf_modem_lib_init();
	if (err) {
		LOG_ERR("Modem library init failed: %d", err);
	}

	read_imei_client_id();

	if (provision_ca_cert()) {
		LOG_ERR("CA certificate provisioning failed - TLS will not work");
	}

	err = lte_lc_connect_async(lte_handler);
	if (err) {
		LOG_ERR("LTE connect failed to start: %d", err);
	} else {
		LOG_INF("Connecting to LTE (can take 1-2 minutes)...");
	}

	manual_loc_init();

	while (true) {
		bool sent = false;
		int64_t now = k_uptime_get();

		if (atomic_set(&button_send, 0)) {
			next_publish = 0;
		}

		network_step(now, &next_connect, &next_publish);

		static int64_t last_environment_sample = -1000;
		static struct env_reading environment;
		if (env_ok &&
		    now - last_environment_sample >=
		    CONFIG_APP_ENV_SAMPLE_INTERVAL_S * MSEC_PER_SEC) {
			last_environment_sample = now;
			env_ok = env_read(&environment) == 0;
		}

		if (env_ok && mqtt_connected &&
		    (now >= next_publish ||
		     atomic_get(&button_send))) {
			if (publish_environment(&environment) == 0) {
				sent = true;
				next_publish = now +
					CONFIG_APP_ENV_PUBLISH_INTERVAL_S * MSEC_PER_SEC;
			}
		}

		update_leds(tick++, sent);
		mqtt_service(MSEC_PER_SEC);
	}

	return 0;
}
```

## src/env.c
```c
#include <errno.h>
#include <zephyr/kernel.h>
#include <zephyr/device.h>
#include <zephyr/drivers/sensor.h>
#include <zephyr/logging/log.h>

#include "env.h"

LOG_MODULE_REGISTER(env, LOG_LEVEL_INF);

static const struct device *bme = DEVICE_DT_GET_OR_NULL(DT_NODELABEL(bme680));

int env_init(void)
{
	if (!bme || !device_is_ready(bme)) {
		LOG_WRN("BME688 not available - no pressure/temperature compensation");
		return -ENODEV;
	}
	return 0;
}

int env_read(struct env_reading *reading)
{
	struct sensor_value pressure, temperature, humidity, gas;
	int err;

	if (!bme || !device_is_ready(bme)) {
		return -ENODEV;
	}

	err = sensor_sample_fetch(bme);
	if (err) {
		return err;
	}

	err = sensor_channel_get(bme, SENSOR_CHAN_PRESS, &pressure);
	if (err) {
		LOG_ERR("Failed to read BME688 pressure: %d", err);
		return err;
	}

	err = sensor_channel_get(bme, SENSOR_CHAN_AMBIENT_TEMP, &temperature);
	if (err) {
		LOG_ERR("Failed to read BME688 temperature: %d", err);
		return err;
	}

	reading->pressure_kpa = (float)sensor_value_to_double(&pressure);
	reading->temperature_c = (float)sensor_value_to_double(&temperature);
	reading->humidity_pct = 0.0f;
	reading->gas_resistance_ohm = 0.0f;

	if (sensor_channel_get(bme, SENSOR_CHAN_HUMIDITY, &humidity) == 0) {
		reading->humidity_pct = (float)sensor_value_to_double(&humidity);
	}
	if (sensor_channel_get(bme, SENSOR_CHAN_GAS_RES, &gas) == 0) {
		reading->gas_resistance_ohm = (float)sensor_value_to_double(&gas);
	}
	return 0;
}
```

## src/env.h
```c
#ifndef ENV_H_
#define ENV_H_

/* Built-in BME688 on the Thingy:91 X. */
struct env_reading {
	float pressure_kpa;
	float temperature_c;
	float humidity_pct;
	float gas_resistance_ohm;
};

int env_init(void);
int env_read(struct env_reading *reading);

#endif /* ENV_H_ */
```

## src/gnss.c
```c
/*
 * Location using the nRF Connect SDK Location library:
 *   Wi-Fi (nRF7002 scan)  -> position looked up by the nRF Cloud location service
 *   GNSS                  -> on the device, sped up with A-GNSS from nRF Cloud
 *   Cellular              -> nearby cell towers, looked up by nRF Cloud
 *
 * The library tries the methods in order and stops at the first success.
 * Only the location lookups go to nRF Cloud (CoAP); sensor data still goes
 * to your own MQTT server.
 *
 * The device must be registered in your nRF Cloud account (Quick Start does
 * this for the Thingy:91 X).
 */

#include <zephyr/kernel.h>
#include <zephyr/logging/log.h>
#include <zephyr/sys/atomic.h>
#include <modem/location.h>
#if defined(CONFIG_NRF_CLOUD_COAP)
#include <net/nrf_cloud_coap.h>
#endif

#include "gnss.h"

LOG_MODULE_REGISTER(gnss, LOG_LEVEL_INF);

static struct k_spinlock lock;
static struct gnss_fix latest;
static bool have_new;
static atomic_t cloud_reconnect;
static bool cloud_ok;

static const char *method_name(enum location_method m)
{
	switch (m) {
	case LOCATION_METHOD_GNSS:
		return "gnss";
#if defined(CONFIG_LOCATION_METHOD_WIFI)
	case LOCATION_METHOD_WIFI:
		return "wifi";
#endif
#if defined(CONFIG_LOCATION_METHOD_CELLULAR)
	case LOCATION_METHOD_CELLULAR:
		return "cell";
#endif
	default:
		return "other";
	}
}

static void location_handler(const struct location_event_data *ev)
{
	switch (ev->id) {
	case LOCATION_EVT_LOCATION: {
		k_spinlock_key_t key = k_spin_lock(&lock);

		latest.lat = ev->location.latitude;
		latest.lon = ev->location.longitude;
		latest.acc_m = ev->location.accuracy;
		latest.method = method_name(ev->method);
		have_new = true;
		k_spin_unlock(&lock, key);

		LOG_INF("Location (%s): %.6f, %.6f (+/- %.0f m)", method_name(ev->method),
			ev->location.latitude, ev->location.longitude,
			(double)ev->location.accuracy);
		break;
	}
	case LOCATION_EVT_TIMEOUT:
		LOG_WRN("Location: no position from any method this time");
		break;
	case LOCATION_EVT_ERROR:
		LOG_WRN("Location: request failed (nRF Cloud lookup?) - will reconnect");
		atomic_set(&cloud_reconnect, 1);
		break;
	case LOCATION_EVT_FALLBACK:
		LOG_INF("Location: %s failed, trying the next method",
			method_name(ev->method));
		break;
	default:
		break;
	}
}

static int cloud_connect(void)
{
#if defined(CONFIG_NRF_CLOUD_COAP)
	int err = nrf_cloud_coap_connect(NULL);

	if (err) {
		LOG_WRN("nRF Cloud connect failed (%d) - Wi-Fi/cell location and A-GNSS "
			"unavailable. Is the device registered in your nRF Cloud account?",
			err);
		return err;
	}
	LOG_INF("Connected to nRF Cloud (location service)");
#endif
	return 0;
}

int gnss_start(void)
{
	int err;

#if defined(CONFIG_NRF_CLOUD_COAP)
	err = nrf_cloud_coap_init();
	if (err) {
		LOG_ERR("nRF Cloud CoAP init failed: %d", err);
	} else {
		cloud_ok = (cloud_connect() == 0);
	}
#endif

	err = location_init(location_handler);
	if (err) {
		LOG_ERR("location_init failed: %d", err);
		return err;
	}

	struct location_config cfg;
	enum location_method methods[] = {
#if defined(CONFIG_LOCATION_METHOD_WIFI) && defined(CONFIG_APP_LOCATION_WIFI_FIRST)
		LOCATION_METHOD_WIFI,
		LOCATION_METHOD_GNSS,
#else
		LOCATION_METHOD_GNSS,
#if defined(CONFIG_LOCATION_METHOD_WIFI)
		LOCATION_METHOD_WIFI,
#endif
#endif
#if defined(CONFIG_LOCATION_METHOD_CELLULAR)
		LOCATION_METHOD_CELLULAR,
#endif
	};

	location_config_defaults_set(&cfg, ARRAY_SIZE(methods), methods);

	cfg.interval = CONFIG_APP_GNSS_INTERVAL_S; /* 0 = single request */
	cfg.timeout = (CONFIG_APP_GNSS_TIMEOUT_S + 120) * MSEC_PER_SEC;

	for (int i = 0; i < cfg.methods_count; i++) {
		if (cfg.methods[i].method == LOCATION_METHOD_GNSS) {
			cfg.methods[i].gnss.timeout = CONFIG_APP_GNSS_TIMEOUT_S * MSEC_PER_SEC;
			cfg.methods[i].gnss.accuracy = LOCATION_ACCURACY_NORMAL;
			/* Without PSM from the network, LTE leaves GNSS almost no radio
			 * time; let GNSS take priority briefly when needed.
			 */
			cfg.methods[i].gnss.priority_mode = true;
		}
	}

	err = location_request(&cfg);
	if (err) {
		LOG_ERR("location_request failed: %d", err);
		return err;
	}

	LOG_INF("Location started: %s, every %d s",
		IS_ENABLED(CONFIG_LOCATION_METHOD_WIFI)
			? (IS_ENABLED(CONFIG_APP_LOCATION_WIFI_FIRST) ? "Wi-Fi -> GNSS -> cell"
								      : "GNSS -> Wi-Fi -> cell")
			: "GNSS -> cell",
		CONFIG_APP_GNSS_INTERVAL_S);
	return 0;
}

void gnss_service(void)
{
#if defined(CONFIG_NRF_CLOUD_COAP)
	static int64_t next_try;

	if ((atomic_get(&cloud_reconnect) || !cloud_ok) && k_uptime_get() >= next_try) {
		atomic_set(&cloud_reconnect, 0);
		next_try = k_uptime_get() + 60 * MSEC_PER_SEC;
		nrf_cloud_coap_disconnect();
		cloud_ok = (cloud_connect() == 0);
	}
#endif
}

bool gnss_take_new_fix(struct gnss_fix *out)
{
	bool ret;
	k_spinlock_key_t key = k_spin_lock(&lock);

	ret = have_new;
	if (ret) {
		*out = latest;
		have_new = false;
	}
	k_spin_unlock(&lock, key);
	return ret;
}
```

## src/gnss.h
```c
#ifndef GNSS_H_
#define GNSS_H_

#include <stdbool.h>

/* A position from GNSS, Wi-Fi or cellular (Location library) */
struct gnss_fix {
	double lat;
	double lon;
	float acc_m;
	const char *method; /* "gnss", "wifi" or "cell" */
};

/* Connect to nRF Cloud (for Wi-Fi/cell lookups and A-GNSS) and start
 * periodic location requests. Call after LTE is connected. Blocks for a
 * few seconds while connecting to nRF Cloud.
 */
int gnss_start(void);

/* Returns true (once) when a new position has arrived since the last call. */
bool gnss_take_new_fix(struct gnss_fix *out);

/* Call from the main loop: reconnects to nRF Cloud after lookup errors. */
void gnss_service(void);

#endif /* GNSS_H_ */
```

## src/iaq_core.c
```c
/*
 * ams iAQ-Core driver (read-only).
 *
 * IMPORTANT (datasheet): never address the iAQ-Core with the WRITE bit -
 * it can lose its configuration and stop responding. This driver only ever
 * uses i2c_read_dt(), which sends the address with the read bit (0xB5).
 *
 * Frame (9 bytes, MSB first):
 *   0-1 CO2-eq prediction (ppm)   2 status   3-6 resistance (Ohm)   7-8 TVOC-eq (ppb)
 */

#include <errno.h>
#include <zephyr/kernel.h>
#include <zephyr/drivers/i2c.h>
#include <zephyr/logging/log.h>

#include "iaq_core.h"

LOG_MODULE_REGISTER(iaq_core, LOG_LEVEL_INF);

static const struct i2c_dt_spec iaq = I2C_DT_SPEC_GET(DT_NODELABEL(iaq_core));

static uint8_t last_status = 0xFF;
static int error_streak;

const char *iaq_status_str(uint8_t status)
{
	switch (status) {
	case IAQ_STATUS_OK:
		return "ok";
	case IAQ_STATUS_BUSY:
		return "busy";
	case IAQ_STATUS_RUNIN:
		return "warmup";
	case IAQ_STATUS_ERROR:
		return "error";
	case IAQ_STATUS_NO_SENSOR:
		return "no_sensor";
	default:
		return "unknown";
	}
}

int iaq_init(void)
{
	if (!i2c_is_ready_dt(&iaq)) {
		LOG_ERR("I2C bus not ready");
		return -ENODEV;
	}

	struct iaq_data d;
	int err = iaq_read(&d);

	if (err) {
		static bool reported;

		/* Report once, then keep retrying quietly */
		if (!reported) {
			LOG_ERR("iAQ-Core not responding at 0x%02x (%d) - check SB8/SB9, power, cable",
				iaq.addr, err);
			reported = true;
		}
		return err;
	}

	LOG_INF("iAQ-Core found (status: %s)", iaq_status_str(d.status));
	return 0;
}

int iaq_read(struct iaq_data *d)
{
	uint8_t b[9];
	int err;

	/* BUSY means multi-byte values may be half-updated: re-read */
	for (int attempt = 0; attempt < 3; attempt++) {
		err = i2c_read_dt(&iaq, b, sizeof(b));
		if (err) {
			return err;
		}
		if (b[2] != IAQ_STATUS_BUSY) {
			break;
		}
		k_msleep(100);
	}

	d->co2_ppm = ((uint16_t)b[0] << 8) | b[1];
	d->status = b[2];
	d->resistance_ohm = ((uint32_t)b[4] << 16) | ((uint32_t)b[5] << 8) | b[6];
	d->tvoc_ppb = ((uint16_t)b[7] << 8) | b[8];

	/* 0xFFFF = "no data" from the sensor: treat as busy, never as a reading */
	if (d->status == IAQ_STATUS_OK && (d->co2_ppm == 0xFFFF || d->tvoc_ppb == 0xFFFF)) {
		LOG_WRN("iAQ-Core returned invalid data (CO2 %u, TVOC %u) - ignored",
			d->co2_ppm, d->tvoc_ppb);
		d->status = IAQ_STATUS_BUSY;
	}

	/* A single ERROR can happen; a constant one means a defective sensor */
	if (d->status == IAQ_STATUS_ERROR) {
		if (++error_streak < CONFIG_IAQ_ERROR_COUNT) {
			d->status = IAQ_STATUS_BUSY; /* treat as "no new data" for now */
		}
	} else {
		error_streak = 0;
	}

	if (d->status != last_status) {
		LOG_INF("iAQ-Core status: %s", iaq_status_str(d->status));
		last_status = d->status;
	}
	return 0;
}
```

## src/iaq_core.h
```c
#ifndef IAQ_CORE_H_
#define IAQ_CORE_H_

#include <stdint.h>

/* Status byte values from the iAQ-Core datasheet */
#define IAQ_STATUS_OK    0x00
#define IAQ_STATUS_BUSY  0x01
#define IAQ_STATUS_RUNIN 0x10 /* warm-up, first valid reading after ~5 min */
#define IAQ_STATUS_ERROR 0x80
#define IAQ_STATUS_NO_SENSOR 0xFE /* not from the sensor: not detected on I2C */

struct iaq_data {
	uint16_t co2_ppm;        /* CO2 equivalent prediction */
	uint16_t tvoc_ppb;       /* TVOC equivalent prediction */
	uint32_t resistance_ohm; /* sensor resistance */
	uint8_t status;
};

int iaq_init(void);

/* Read all 9 bytes. Returns 0 if the bus transfer worked (check d->status). */
int iaq_read(struct iaq_data *d);

const char *iaq_status_str(uint8_t status);

#endif /* IAQ_CORE_H_ */
```

## src/manual_loc.c
```c
/*
 * Manual location over the serial terminal (115200 baud), saved in flash:
 *
 *   loc set -26.107600 28.056700   use this position (overrides GNSS/Wi-Fi/cell)
 *   loc clear                      back to automatic location
 *   loc show                       print the current setting
 */

#include <stdlib.h>
#include <string.h>
#include <zephyr/kernel.h>
#include <zephyr/shell/shell.h>
#include <zephyr/settings/settings.h>
#include <zephyr/sys/atomic.h>
#include <zephyr/logging/log.h>

#include "manual_loc.h"

LOG_MODULE_REGISTER(manual_loc, LOG_LEVEL_INF);

struct loc_store {
	double lat;
	double lon;
};

static struct k_spinlock lock;
static struct loc_store loc;
static bool active;
static atomic_t changed;

static int loc_settings_set(const char *name, size_t len, settings_read_cb read_cb, void *cb_arg)
{
	const char *next;

	if (settings_name_steq(name, "pos", &next) && !next) {
		struct loc_store tmp;

		if (len == sizeof(tmp) && read_cb(cb_arg, &tmp, sizeof(tmp)) == sizeof(tmp)) {
			loc = tmp;
			active = true;
		}
		return 0;
	}
	return -ENOENT;
}

SETTINGS_STATIC_HANDLER_DEFINE(manual_loc, "loc", NULL, loc_settings_set, NULL, NULL);

void manual_loc_init(void)
{
	if (settings_subsys_init() == 0) {
		settings_load_subtree("loc");
	}

	/* Fallback: location from prj.conf (CONFIG_APP_FIXED_LAT / _LON) */
	if (!active && strlen(CONFIG_APP_FIXED_LAT) > 0 && strlen(CONFIG_APP_FIXED_LON) > 0) {
		loc.lat = strtod(CONFIG_APP_FIXED_LAT, NULL);
		loc.lon = strtod(CONFIG_APP_FIXED_LON, NULL);
		active = true;
	}

	if (active) {
		LOG_INF("Manual location: %.6f, %.6f (type 'loc clear' for automatic)", loc.lat,
			loc.lon);
		atomic_set(&changed, 1);
	} else {
		LOG_INF("No manual location. Set one with: loc set <lat> <lon>");
	}
}

bool manual_loc_get(double *lat, double *lon)
{
	k_spinlock_key_t key = k_spin_lock(&lock);
	bool ret = active;

	*lat = loc.lat;
	*lon = loc.lon;
	k_spin_unlock(&lock, key);
	return ret;
}

bool manual_loc_changed(void)
{
	return atomic_cas(&changed, 1, 0);
}

/* ---------------- Shell commands ---------------- */

static int cmd_set(const struct shell *sh, size_t argc, char **argv)
{
	char *end1, *end2;
	double lat = strtod(argv[1], &end1);
	double lon = strtod(argv[2], &end2);

	if (*end1 || *end2 || lat < -90 || lat > 90 || lon < -180 || lon > 180) {
		shell_error(sh, "Use decimal degrees, e.g.: loc set -26.107600 28.056700");
		return -EINVAL;
	}

	k_spinlock_key_t key = k_spin_lock(&lock);

	loc.lat = lat;
	loc.lon = lon;
	active = true;
	k_spin_unlock(&lock, key);

	struct loc_store save = { .lat = lat, .lon = lon };
	int err = settings_save_one("loc/pos", &save, sizeof(save));

	atomic_set(&changed, 1);
	shell_print(sh, "Manual location set: %.6f, %.6f%s - sending now", lat, lon,
		    err ? " (NOT saved to flash)" : " (saved)");
	return 0;
}

static int cmd_clear(const struct shell *sh, size_t argc, char **argv)
{
	k_spinlock_key_t key = k_spin_lock(&lock);

	active = false;
	k_spin_unlock(&lock, key);

	settings_delete("loc/pos");
	atomic_set(&changed, 1);
	shell_print(sh, "Manual location cleared - using GNSS / Wi-Fi / cell again");
	return 0;
}

static int cmd_show(const struct shell *sh, size_t argc, char **argv)
{
	double lat, lon;

	if (manual_loc_get(&lat, &lon)) {
		shell_print(sh, "Manual location: %.6f, %.6f", lat, lon);
	} else {
		shell_print(sh, "No manual location (automatic GNSS / Wi-Fi / cell)");
	}
	return 0;
}

SHELL_STATIC_SUBCMD_SET_CREATE(loc_cmds,
	SHELL_CMD_ARG(set, NULL, "Set location: loc set <lat> <lon>", cmd_set, 3, 0),
	SHELL_CMD(clear, NULL, "Back to automatic location", cmd_clear),
	SHELL_CMD(show, NULL, "Show the current location setting", cmd_show),
	SHELL_SUBCMD_SET_END);

SHELL_CMD_REGISTER(loc, &loc_cmds, "Manual location for the dashboard map", NULL);
```

## src/manual_loc.h
```c
#ifndef MANUAL_LOC_H_
#define MANUAL_LOC_H_

#include <stdbool.h>

/* Load the manual location saved in flash (set with the "loc" serial command). */
void manual_loc_init(void);

/* True while a manual location is set (it then overrides GNSS/Wi-Fi/cell). */
bool manual_loc_get(double *lat, double *lon);

/* Returns true (once) after "loc set" or "loc clear" was typed. */
bool manual_loc_changed(void);

#endif /* MANUAL_LOC_H_ */
```

## src/o2_sensor.c
```c
/*
 * Analog O2 sensor read through an ADS1115 on the Qwiic port (default) or the
 * nRF9151 built-in ADC - selected in the devicetree (see boards/ and overlays/).
 *
 * Two-point linear conversion:
 *
 *   O2 % = span_pct * (V - V_zero) / (V_span - V_zero)
 *
 *   V_zero  : output at 0 % O2  (zero calibration in N2, or datasheet offset)
 *   V_span  : output at span_pct (air calibration = 20.9 %, or a span gas)
 *             until calibrated, the datasheet nominal output in air is used
 *
 * Optional compensation:
 *   pressure    : O2 % *= P_cal / P_now                    (CONFIG_O2_PRESSURE_COMP)
 *   temperature : O2 % /= 1 + k * (T_now - T_cal)           (CONFIG_O2_TEMP_COEFF_PPM_C)
 */

#include <errno.h>
#include <stdio.h>
#include <stdlib.h>
#include <zephyr/kernel.h>
#include <zephyr/drivers/adc.h>
#include <zephyr/settings/settings.h>
#include <zephyr/logging/log.h>
#include <date_time.h>

#include "o2_sensor.h"

LOG_MODULE_REGISTER(o2_sensor, LOG_LEVEL_INF);

#define O2_AIR_PCT  20.9f
#define CAL_VERSION 1

static const struct adc_dt_spec adc_ch = ADC_DT_SPEC_GET(DT_PATH(zephyr_user));

/* Stored in flash as one blob */
struct cal_data {
	uint8_t version;
	uint8_t has_span;
	uint8_t has_zero;
	uint8_t reserved;
	int32_t zero_uv;
	int32_t span_uv;
	float span_pct;
	float p_cal_kpa;
	float t_cal_c;
	int64_t span_time;
	int64_t zero_time;
};

static struct cal_data cal;

static int32_t samples_uv[CONFIG_O2_AVG_SAMPLES];
static uint8_t sample_count;
static uint8_t sample_idx;

static bool env_ok;
static float env_p_kpa;
static float env_t_c;

static void cal_defaults(void)
{
	cal = (struct cal_data){
		.version = CAL_VERSION,
		.zero_uv = CONFIG_O2_ZERO_OFFSET_UV,
		.span_uv = CONFIG_O2_AIR_NOMINAL_UV,
		.span_pct = O2_AIR_PCT,
	};
}

static int64_t now_unix_s(void)
{
	int64_t ms;

	if (date_time_now(&ms) == 0) {
		return ms / 1000;
	}
	return 0;
}

/* ---------------- Settings (flash) ---------------- */

static int o2_settings_set(const char *name, size_t len, settings_read_cb read_cb, void *cb_arg)
{
	const char *next;

	if (settings_name_steq(name, "cal", &next) && !next) {
		struct cal_data tmp;

		if (len != sizeof(tmp) || read_cb(cb_arg, &tmp, sizeof(tmp)) != sizeof(tmp) ||
		    tmp.version != CAL_VERSION) {
			LOG_WRN("Stored calibration invalid, using datasheet values");
			return 0;
		}
		cal = tmp;
		return 0;
	}
	return -ENOENT;
}

SETTINGS_STATIC_HANDLER_DEFINE(o2, "o2", NULL, o2_settings_set, NULL, NULL);

static void cal_save(void)
{
	int err = settings_save_one("o2/cal", &cal, sizeof(cal));

	if (err) {
		LOG_WRN("Calibration not saved to flash (%d)", err);
	}
}

static void reset_average(void)
{
	sample_count = 0;
	sample_idx = 0;
}

/* ---------------- ADC ---------------- */

static int read_uv(int32_t *uv)
{
	int16_t buf;
	struct adc_sequence seq = {
		.buffer = &buf,
		.buffer_size = sizeof(buf),
	};
	int err;

	static uint32_t reads;

	adc_sequence_init_dt(&adc_ch, &seq);

	/* nRF SAADC: offset calibration at start and every ~10 minutes
	 * (the ADS1115 driver ignores this flag)
	 */
	seq.calibrate = (reads++ % 600) == 0;

	err = adc_read_dt(&adc_ch, &seq);
	if (err) {
		LOG_ERR("ADC read failed: %d", err);
		return err;
	}

	int32_t val = buf;

	err = adc_raw_to_microvolts_dt(&adc_ch, &val);
	if (err) {
		return err;
	}

	*uv = val;
	return 0;
}

int o2_sensor_init(void)
{
	int err;

	if (!adc_is_ready_dt(&adc_ch)) {
		LOG_ERR("O2 ADC not ready (ADS1115: check wiring and I2C address)");
		return -ENODEV;
	}

	err = adc_channel_setup_dt(&adc_ch);
	if (err) {
		LOG_ERR("ADC channel setup failed: %d", err);
		return err;
	}

	cal_defaults();
	err = settings_subsys_init();
	if (!err) {
		settings_load_subtree("o2");
	} else {
		LOG_WRN("Settings init failed (%d), calibration will not be saved", err);
	}

	LOG_INF("O2 sensor ready: zero %d uV%s, span %d uV = %.2f %%%s", cal.zero_uv,
		cal.has_zero ? " (calibrated)" : " (datasheet)", cal.span_uv,
		(double)cal.span_pct, cal.has_span ? " (calibrated)" : " (datasheet - please calibrate)");
	return 0;
}

int o2_sensor_sample(void)
{
	int32_t uv;
	int err = read_uv(&uv);

	if (err) {
		return err;
	}

	samples_uv[sample_idx] = uv;
	sample_idx = (sample_idx + 1) % CONFIG_O2_AVG_SAMPLES;
	if (sample_count < CONFIG_O2_AVG_SAMPLES) {
		sample_count++;
	}
	return 0;
}

void o2_sensor_set_env(bool valid, float pressure_kpa, float temp_c)
{
	env_ok = valid;
	env_p_kpa = pressure_kpa;
	env_t_c = temp_c;
}

static float uv_to_pct(float uv)
{
	float span = (float)(cal.span_uv - cal.zero_uv);
	float pct = cal.span_pct * (uv - (float)cal.zero_uv) / span;

#if defined(CONFIG_O2_PRESSURE_COMP)
	if (env_ok && cal.p_cal_kpa > 0.0f && env_p_kpa > 50.0f) {
		pct *= cal.p_cal_kpa / env_p_kpa;
	}
#endif

#if CONFIG_O2_TEMP_COEFF_PPM_C != 0
	if (env_ok && cal.p_cal_kpa > 0.0f) { /* T_cal is recorded together with P_cal */
		float k = (float)CONFIG_O2_TEMP_COEFF_PPM_C * 1e-6f;

		pct /= 1.0f + k * (env_t_c - cal.t_cal_c);
	}
#endif

	return pct < 0.0f ? 0.0f : pct;
}

/* Output in air implied by the current calibration (for health + limits) */
static float air_equiv_uv(int32_t zero_uv, int32_t span_uv, float span_pct)
{
	return (float)zero_uv + (float)(span_uv - zero_uv) * O2_AIR_PCT / span_pct;
}

void o2_sensor_get_cal_info(struct o2_cal_info *out)
{
	int64_t now = now_unix_s();

	out->has_span = cal.has_span;
	out->has_zero = cal.has_zero;
	out->zero_uv = cal.zero_uv;
	out->span_uv = cal.span_uv;
	out->span_pct = cal.span_pct;
	out->span_time = cal.span_time;
	out->zero_time = cal.zero_time;
	out->p_cal_kpa = cal.p_cal_kpa;
	out->t_cal_c = cal.t_cal_c;

	out->health_pct = -1;
	if (cal.has_span) {
		float nominal = (float)(CONFIG_O2_AIR_NOMINAL_UV - CONFIG_O2_ZERO_OFFSET_UV);
		float actual = air_equiv_uv(cal.zero_uv, cal.span_uv, cal.span_pct) -
			       (float)cal.zero_uv;

		out->health_pct = (int)(100.0f * actual / nominal + 0.5f);
	}

	out->cal_age_days = -1;
	if (cal.has_span && cal.span_time > 0 && now > 0) {
		out->cal_age_days = (int)((now - cal.span_time) / 86400);
	}

	out->cal_due = !cal.has_span;
#if CONFIG_O2_CAL_INTERVAL_DAYS > 0
	if (out->cal_age_days >= CONFIG_O2_CAL_INTERVAL_DAYS) {
		out->cal_due = true;
	}
#endif
}

bool o2_sensor_get(struct o2_reading *out)
{
	if (sample_count == 0) {
		return false;
	}

	int64_t sum = 0;

	for (int i = 0; i < sample_count; i++) {
		sum += samples_uv[i];
	}

	float avg_uv = (float)sum / sample_count;
	struct o2_cal_info info;

	o2_sensor_get_cal_info(&info);

	out->sensor_mv = avg_uv / 1000.0f;
	out->o2_pct = uv_to_pct(avg_uv);
	out->calibrated = cal.has_span;
	out->cal_due = info.cal_due;
	out->fault = avg_uv < CONFIG_O2_SENSOR_FAULT_UV;
	out->env_valid = env_ok;
	out->pressure_kpa = env_p_kpa;
	out->temp_c = env_t_c;
	return true;
}

/* ---------------- Calibration ---------------- */

/* Average over the whole window; stability judged on the second half */
static int measure(int duration_s, void (*cb)(void), int32_t *avg, int32_t *spread)
{
	const int n = (duration_s * 1000) / CONFIG_O2_SAMPLE_INTERVAL_MS;
	int64_t sum = 0;
	int good = 0;
	int32_t lo = INT32_MAX, hi = INT32_MIN;

	for (int i = 0; i < n; i++) {
		int32_t uv;

		if (read_uv(&uv) == 0) {
			sum += uv;
			good++;
			if (i >= n / 2) {
				lo = MIN(lo, uv);
				hi = MAX(hi, uv);
			}
		}
		if (cb) {
			cb();
		}
		k_msleep(CONFIG_O2_SAMPLE_INTERVAL_MS);
	}

	if (good < n / 2 || hi < lo) {
		return -EIO;
	}

	*avg = (int32_t)(sum / good);
	*spread = hi - lo;
	return 0;
}

int o2_sensor_calibrate(enum o2_cal_type type, float gas_pct, void (*progress_cb)(void),
			char *msg, size_t msg_len)
{
	int32_t avg, spread;
	int err;

	if (type == O2_CAL_AIR) {
		gas_pct = O2_AIR_PCT;
	} else if (type == O2_CAL_SPAN && (gas_pct < 5.0f || gas_pct > 100.0f)) {
		snprintf(msg, msg_len, "Span gas must be 5-100 %% O2 (got %.2f)", (double)gas_pct);
		return -EINVAL;
	}

	int duration = (type == O2_CAL_ZERO) ? CONFIG_O2_ZERO_CAL_DURATION_S
					     : CONFIG_O2_CAL_DURATION_S;

	LOG_INF("Calibration (%s) started, %d s",
		type == O2_CAL_AIR ? "air" : type == O2_CAL_SPAN ? "span gas" : "zero",
		duration);

	err = measure(duration, progress_cb, &avg, &spread);
	if (err) {
		snprintf(msg, msg_len, "Calibration failed: ADC errors");
		return err;
	}

	if (spread > CONFIG_O2_CAL_STABLE_UV) {
		snprintf(msg, msg_len,
			 "Not stable: reading moved %d uV (max %d). Wait longer and retry",
			 spread, CONFIG_O2_CAL_STABLE_UV);
		return -EAGAIN;
	}

	if (type == O2_CAL_ZERO) {
		if (abs(avg) > CONFIG_O2_ZERO_MAX_UV) {
			snprintf(msg, msg_len,
				 "Zero rejected: %d uV is above the datasheet max %d uV. Is the "
				 "sensor really in pure nitrogen?",
				 avg, CONFIG_O2_ZERO_MAX_UV);
			return -ERANGE;
		}
		float air = air_equiv_uv(avg, cal.span_uv, cal.span_pct);

		if (air < CONFIG_O2_AIR_MIN_UV || air > CONFIG_O2_AIR_MAX_UV) {
			snprintf(msg, msg_len,
				 "Zero rejected: does not fit the stored span calibration");
			return -ERANGE;
		}
		cal.zero_uv = avg;
		cal.has_zero = 1;
		cal.zero_time = now_unix_s();
		snprintf(msg, msg_len, "Zero calibration OK: %d uV = 0 %% O2", avg);
	} else {
		float air = air_equiv_uv(cal.zero_uv, avg, gas_pct);

		if (avg <= cal.zero_uv || air < CONFIG_O2_AIR_MIN_UV ||
		    air > CONFIG_O2_AIR_MAX_UV) {
			snprintf(msg, msg_len,
				 "Rejected: %d uV at %.2f %% is outside the datasheet window "
				 "(%d-%d uV in air)",
				 avg, (double)gas_pct, CONFIG_O2_AIR_MIN_UV, CONFIG_O2_AIR_MAX_UV);
			return -ERANGE;
		}
		cal.span_uv = avg;
		cal.span_pct = gas_pct;
		cal.has_span = 1;
		cal.span_time = now_unix_s();
		/* Remember conditions for pressure/temperature compensation */
		cal.p_cal_kpa = env_ok ? env_p_kpa : 0.0f;
		cal.t_cal_c = env_ok ? env_t_c : 0.0f;
		snprintf(msg, msg_len, "%s calibration OK: %d uV = %.2f %% O2%s",
			 type == O2_CAL_AIR ? "Air" : "Span gas", avg, (double)gas_pct,
			 env_ok ? "" : " (no pressure reference)");
	}

	cal_save();
	reset_average();
	LOG_INF("%s", msg);
	return 0;
}

int o2_sensor_cal_set(int32_t zero_uv, int32_t span_uv, float span_pct, char *msg,
		      size_t msg_len)
{
	if (span_pct < 5.0f || span_pct > 100.0f || abs(zero_uv) > CONFIG_O2_ZERO_MAX_UV ||
	    span_uv <= zero_uv) {
		snprintf(msg, msg_len, "Manual values rejected: check zero/span/pct");
		return -EINVAL;
	}

	float air = air_equiv_uv(zero_uv, span_uv, span_pct);

	if (air < CONFIG_O2_AIR_MIN_UV || air > CONFIG_O2_AIR_MAX_UV) {
		snprintf(msg, msg_len, "Manual values rejected: outside datasheet window");
		return -ERANGE;
	}

	int64_t now = now_unix_s();

	cal.zero_uv = zero_uv;
	cal.span_uv = span_uv;
	cal.span_pct = span_pct;
	cal.has_zero = 1;
	cal.has_span = 1;
	cal.zero_time = now;
	cal.span_time = now;
	cal.p_cal_kpa = 0.0f; /* unknown conditions: no pressure compensation */
	cal.t_cal_c = 0.0f;

	cal_save();
	reset_average();
	snprintf(msg, msg_len, "Manual calibration set: zero %d uV, %d uV = %.2f %%", zero_uv,
		 span_uv, (double)span_pct);
	LOG_INF("%s", msg);
	return 0;
}

int o2_sensor_cal_reset(void)
{
	cal_defaults();
	settings_delete("o2/cal");
	reset_average();
	LOG_INF("Calibration reset to datasheet values");
	return 0;
}
```

## src/o2_sensor.h
```c
#ifndef O2_SENSOR_H_
#define O2_SENSOR_H_

#include <stdbool.h>
#include <stddef.h>
#include <stdint.h>

int o2_sensor_init(void);

/* Take one ADC sample and add it to the moving average. */
int o2_sensor_sample(void);

/* Latest pressure/temperature for compensation (call from the main loop). */
void o2_sensor_set_env(bool valid, float pressure_kpa, float temp_c);

struct o2_reading {
	float o2_pct;       /* oxygen in % vol (compensated) */
	float sensor_mv;    /* averaged raw sensor output in mV */
	bool calibrated;    /* span calibration stored (otherwise datasheet nominal) */
	bool cal_due;       /* never calibrated, or calibration older than the interval */
	bool fault;         /* output implausibly low (disconnected?) */
	bool env_valid;
	float pressure_kpa;
	float temp_c;
};
bool o2_sensor_get(struct o2_reading *out);

/* ---------- Calibration ---------- */

enum o2_cal_type {
	O2_CAL_AIR,   /* fresh air, 20.9 % O2 */
	O2_CAL_SPAN,  /* certified span gas, concentration given */
	O2_CAL_ZERO,  /* 0 % O2 (pure nitrogen) */
};

/*
 * Measure and store a calibration point. Blocks for the calibration duration.
 * progress_cb is called every sample (e.g. to blink an LED).
 * A human-readable result is written to msg.
 * Returns 0 on success, -ERANGE (outside datasheet limits), -EAGAIN (not stable),
 * -EINVAL (bad parameters) or -EIO (ADC errors).
 */
int o2_sensor_calibrate(enum o2_cal_type type, float gas_pct, void (*progress_cb)(void),
			char *msg, size_t msg_len);

/* Enter calibration values by hand (e.g. from a lab certificate). */
int o2_sensor_cal_set(int32_t zero_uv, int32_t span_uv, float span_pct, char *msg,
		      size_t msg_len);

/* Forget all calibration and go back to the datasheet values. */
int o2_sensor_cal_reset(void);

struct o2_cal_info {
	bool has_span;
	bool has_zero;
	int32_t zero_uv;
	int32_t span_uv;
	float span_pct;
	int64_t span_time;    /* unix seconds, 0 = unknown */
	int64_t zero_time;
	float p_cal_kpa;      /* 0 = not recorded */
	float t_cal_c;
	int health_pct;       /* output vs datasheet nominal, -1 = unknown */
	int cal_age_days;     /* -1 = unknown */
	bool cal_due;
};
void o2_sensor_get_cal_info(struct o2_cal_info *out);

#endif /* O2_SENSOR_H_ */
```
